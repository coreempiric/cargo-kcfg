## examples/workspace/lib/src/Kconfig.test
```kconfig
mainmenu "Workspace cargo-kconfig example"

config FOO
	bool "Enable foo feature"
	default y

config BUFFER_SIZE
	int "Buffer size in bytes"
	range 1 4096
	default 128
	depends on FOO

config BOARD_NAME
	string "Board name"
	default "qemu"

config BUS
	bool "Peripheral bus"
	default n

config UART
	bool "UART driver"
	depends on BUS
	default n
```

## tests/fixtures/choice_conflict/Kconfig
```kconfig
choice
	prompt "Console backend"

config UART_CONSOLE
	bool "UART console"

config RTT_CONSOLE
	bool "RTT console"
endchoice
```

## tests/fixtures/choice_ok/Kconfig
```kconfig
choice
	prompt "Console backend"
	default UART_CONSOLE

config UART_CONSOLE
	bool "UART console"

config RTT_CONSOLE
	bool "RTT console"

config USB_CONSOLE
	bool "USB console"
endchoice

config CONSOLE_BAUD
	int "UART baud rate"
	depends on UART_CONSOLE
	range 1200 921600
	default 115200
```

## tests/fixtures/cyclic_depends/Kconfig
```kconfig
config A
	bool
	depends on B
	default y

config B
	bool
	depends on A
	default y
```

## tests/fixtures/depends_unmet/Kconfig
```kconfig
config DEP
	bool "Dependency"
	default n

config CHILD
	bool "Child"
	depends on DEP
	default n
```

## tests/fixtures/happy_sourced/Kconfig
```kconfig
mainmenu "Minimal cargo-kcfg example"

config FOO
	bool "Enable foo"
	default y

config BUFFER_SIZE
	int "Buffer size"
	range 1 4096
	default 128
	depends on FOO

config BOARD_NAME
	string "Board name"
	default "qemu"

config FEATURE
	bool "Optional feature"
	default n
	depends on FOO

config DMA_ADDR
	hex "DMA address"
	default 0x1000

source "Kconfig.board"
```

## tests/fixtures/happy_sourced/qemu_defconfig
```kconfig
CONFIG_FOO=y
CONFIG_BUFFER_SIZE=256
CONFIG_BOARD_NAME="qemu-virt"
CONFIG_FEATURE=y
CONFIG_DMA_ADDR=0x2000
CONFIG_BOARD_EXTRA=y
```

## tests/fixtures/select_imply/Kconfig
```kconfig
config HAS_UART
	bool

config UART
	bool "UART"
	select HAS_UART

config BUS
	bool

config HAS_DMA
	bool
	depends on BUS

config DRIVER
	bool
	select HAS_DMA

config LOG
	bool

config DEBUG
	bool
	imply LOG
```
