## examples/depends/Kconfig
```kconfig
mainmenu "Dependency and visibility example"

config BUS
	bool "Enable the shared peripheral bus"
	default y

config UART
	bool "UART driver"
	depends on BUS
	default y

config UART_DMA
	bool "UART DMA (needs the bus and UART)"
	depends on BUS && UART
	default n

config RTT
	bool "RTT console (does not need the bus)"
	default n

config CONSOLE
	bool "Text console"
	depends on UART || RTT
	default y

config POLL_LOOP
	bool "Busy-poll loop used only when the bus is off"
	depends on !BUS
	default y

if UART
config UART_BAUD
	int "UART baud rate"
	range 1200 921600
	default 115200
endif
```

## examples/depends/bus_defconfig
```kconfig
CONFIG_BUS=y
CONFIG_UART=y
CONFIG_UART_DMA=y
CONFIG_RTT=n
CONFIG_CONSOLE=y
CONFIG_UART_BAUD=115200
```

## examples/errors/ok_defconfig
```kconfig
CONFIG_BUS=y
CONFIG_UART=y
CONFIG_UART_IRQ=y
CONFIG_DMA_DRIVER=y
CONFIG_BOARD_WANTS_RTC=y
CONFIG_UART_CONSOLE=y
CONFIG_BUF_SIZE=16
```

## examples/firmware/Kconfig
```kconfig
mainmenu "Firmware board configuration"

config BOARD_QEMU
	bool "QEMU virt board"
	default y

config BOARD_HAS_SENSOR
	bool
	default y if BOARD_QEMU

config HAS_FPU
	def_bool y

config FLASH_BASE
	hex "Flash base address"
	default 0x8000000

menu "Logging"

config LOGGING
	bool "Enable logging"
	default y

config LOG_LEVEL
	int "Log verbosity"
	range 0 5
	default 5 if LOGGING
	default 0
	depends on LOGGING

endmenu

menu "Networking"

# Hidden helper forced on by NETWORK via `select`.
config HAS_NET
	bool

config NETWORK
	bool "Enable networking"
	select HAS_NET
	default y

config NET_DRIVER
	tristate "Network interface driver"
	depends on NETWORK
	default y

config TCP
	bool "TCP"
	depends on NETWORK
	default y

config UDP
	bool "UDP"
	depends on NETWORK
	default n

config TLS
	bool "TLS (requires TCP)"
	depends on NETWORK && TCP
	default n

config NET_BUFFER
	int "Network buffer bytes"
	range 64 8192
	default 2048 if TCP
	default 512 if UDP
	default 128
	depends on NETWORK

endmenu

if NETWORK
source "Kconfig.net"
endif

config SPI
	bool "SPI controller"
	default y

config SENSOR
	bool "On-board SPI sensor"
	depends on SPI && BOARD_HAS_SENSOR
	default y

config BARE_METAL_HOOKS
	bool "Hooks used only when networking is disabled"
	depends on !NETWORK
	default y
```

## examples/firmware/Kconfig.net
```kconfig
config DHCP
	bool "DHCP client"
	depends on NETWORK
	default y if UDP
	default n

config MDNS
	bool "mDNS responder"
	depends on NETWORK && UDP
	default n
```

## examples/firmware/debug_defconfig
```kconfig
CONFIG_BOARD_QEMU=y
CONFIG_LOGGING=y
CONFIG_LOG_LEVEL=5
CONFIG_NETWORK=y
CONFIG_NET_DRIVER=y
CONFIG_TCP=y
CONFIG_UDP=y
CONFIG_TLS=y
CONFIG_NET_BUFFER=4096
CONFIG_DHCP=y
CONFIG_MDNS=y
CONFIG_SPI=y
CONFIG_SENSOR=y
CONFIG_FLASH_BASE=0x8000000
```

## examples/firmware/prod_defconfig
```kconfig
CONFIG_BOARD_QEMU=y
CONFIG_LOGGING=n
CONFIG_NETWORK=n
CONFIG_SPI=y
CONFIG_SENSOR=y
CONFIG_BARE_METAL_HOOKS=y
CONFIG_FLASH_BASE=0x8000000
```

## examples/minimal/Kconfig
```kconfig
mainmenu "Minimal cargo-kcfg example"

config FOO
	bool "Enable foo feature"
	default y

config BUFFER_SIZE
	int "Buffer size in bytes"
	range 1 4096
	default 128
	depends on FOO

config BOARD_NAME
	string "Board name"
	default "qemu"

config FEATURE
	bool "Optional compile-time feature"
	default n
	depends on FOO

source "Kconfig.board"
```

## examples/minimal/qemu_defconfig
```kconfig
CONFIG_FOO=y
CONFIG_BUFFER_SIZE=256
CONFIG_BOARD_NAME="qemu-virt"
CONFIG_FEATURE=y
CONFIG_BOARD_EXTRA=y
```
